## firmware/sdkconfig.defaults
```kconfig
# Partition table
CONFIG_PARTITION_TABLE_CUSTOM=y
CONFIG_PARTITION_TABLE_CUSTOM_FILENAME="partitions.csv"

# OTA
CONFIG_BOOTLOADER_APP_ROLLBACK_ENABLE=y

# FreeRTOS
CONFIG_FREERTOS_HZ=1000
CONFIG_FREERTOS_UNICORE=n

# WiFi
CONFIG_ESP_WIFI_STATIC_RX_BUFFER_NUM=4
CONFIG_ESP_WIFI_DYNAMIC_RX_BUFFER_NUM=8

# MQTT
CONFIG_MQTT_BUFFER_SIZE=4096

# Security
CONFIG_ESP_SYSTEM_EVENT_TASK_STACK_SIZE=4096
CONFIG_MBEDTLS_SSL_MAX_CONTENT_LEN=8192

# Logging
CONFIG_LOG_DEFAULT_LEVEL_INFO=y

# Deep sleep
CONFIG_ESP_SLEEP_POWER_DOWN_FLASH=y

# BLE (for WiFi provisioning)
CONFIG_BT_ENABLED=y
CONFIG_BT_BLE_ENABLED=y
CONFIG_BT_BLUEDROID_ENABLED=y
CONFIG_BT_CLASSIC_ENABLED=n
CONFIG_BTDM_CTRL_MODE_BLE_ONLY=y
CONFIG_BT_BLE_50_FEATURES_SUPPORTED=y
CONFIG_BT_GATT_MAX_SR_PROFILES=1
CONFIG_BT_GATT_MAX_SR_ATTRIBUTES=16

# WebSocket
CONFIG_WS_TRANSPORT_MAX_CONTROL_FRAME_BUFFER_LEN=128
CONFIG_ESP_WEBSOCKET_CLIENT_ENABLE=y

# TLS
CONFIG_ESP_TLS_INSECURE=n
CONFIG_ESP_TLS_SKIP_SERVER_CERT_VERIFY=n
CONFIG_MBEDTLS_CERTIFICATE_BUNDLE=y
CONFIG_MBEDTLS_TLS_CLIENT=y

# Flash encryption (enable in production)
# CONFIG_FLASH_ENCRYPTION_ENABLED=y
# CONFIG_SECURE_BOOT=y
```
